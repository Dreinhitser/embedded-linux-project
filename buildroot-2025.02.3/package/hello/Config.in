## buildroot-2025.02.3/package/hello/Config.in
```kconfig
config BR2_PACKAGE_HELLO
    bool "hello kernel module"
    help
      This is a simple Hello World kernel module.
```

## buildroot-2025.02.3/package/my_module/Config.in
```kconfig
config BR2_PACKAGE_HELLO_KERNEL_MODULE
    bool "hello kernel module"
    help
      This is a simple Hello World kernel module.
```
